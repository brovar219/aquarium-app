## main/Kconfig.projbuild
```kconfig
menu "Aquarium Wi-Fi"

    config AQUARIUM_WIFI_SSID
        string "WiFi SSID"
        default "myssid"
        help
            SSID точки доступу для режиму STA.

    config AQUARIUM_WIFI_PASSWORD
        string "WiFi Password"
        default "mypassword"
        help
            Пароль Wi-Fi (зберігається у образі — для виробництва використовуйте NVS або provisioning).

endmenu
```

## sdkconfig.defaults
```kconfig
# Цільовий чип: esp32c6 (задайте: idf.py set-target esp32c6)
# Два слоти OTA для оновлення прошивки через веб (POST /update).
# CONFIG_PARTITION_TABLE_SINGLE_APP_LARGE is not set
CONFIG_PARTITION_TABLE_TWO_OTA_LARGE=y

# Дев-плати ESP32-C6 зазвичай мають 4MB+ флешу; TWO_OTA_LARGE потребує ~3.5MB.
CONFIG_ESPTOOLPY_FLASHSIZE_4MB=y
CONFIG_ESPTOOLPY_FLASHSIZE="4MB"

# Wi-Fi STA: задаються через menuconfig → Aquarium Wi-Fi
CONFIG_AQUARIUM_WIFI_SSID="Home"
CONFIG_AQUARIUM_WIFI_PASSWORD="igor2197576"

CONFIG_ESP_WIFI_STATIC_RX_BUFFER_NUM=10
CONFIG_ESP_WIFI_DYNAMIC_RX_BUFFER_NUM=32
CONFIG_ESP_WIFI_AMPDU_TX_ENABLED=y
CONFIG_ESP_WIFI_AMPDU_RX_ENABLED=y

CONFIG_HTTPD_MAX_REQ_HDR_LEN=2048
CONFIG_HTTPD_WS_SUPPORT=y

CONFIG_ESP_INT_WDT_TIMEOUT_MS=800
CONFIG_FREERTOS_HZ=1000

CONFIG_LWIP_MAX_SOCKETS=16
```
